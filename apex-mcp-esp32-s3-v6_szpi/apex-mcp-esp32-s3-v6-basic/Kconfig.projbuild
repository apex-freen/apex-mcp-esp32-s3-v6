## apex-mcp-esp32-s3-v6_szpi/apex-mcp-esp32-s3-v6-basic/Kconfig.projbuild
```kconfig
menu "APEX Debug"

config APEX_DEBUG_PAYLOAD
    bool "打印加解密明文（仅联调用）"
    default n
    help
      开启后在 DEBUG 级别打印加解密前后的明文/密文，
      用于与 apex_mcp_bridge 联调验证链路。
      量产构建必须关闭（编译期裁剪，不参与代码生成）。

endmenu
```

## apex-mcp-esp32-s3-v6_szpi/apex-mcp-esp32-s3-v6-basic/sdkconfig.defaults
```kconfig
# sdkconfig.defaults —— 量产构建（明文日志关闭，编译期裁剪）
CONFIG_APEX_DEBUG_PAYLOAD=n
CONFIG_LOG_DEFAULT_LEVEL_WARN=y

# ---- PSRAM 内存策略（借鉴实战派 14-handheld）----
CONFIG_SPIRAM=y
CONFIG_SPIRAM_MODE_OCT=y
CONFIG_SPIRAM_SPEED_80M=y
# 小于 2KB 的分配强制留在内部 DRAM，大块自动进 PSRAM
CONFIG_SPIRAM_MALLOC_ALWAYSINTERNAL=2048
# WiFi/LWIP 缓冲可放 PSRAM，节省内部 DRAM
CONFIG_SPIRAM_TRY_ALLOCATE_WIFI_LWIP=y
```

## apex-mcp-esp32-s3-v6_szpi/apex-mcp-esp32-s3-v6-basic/sdkconfig.defaults.debug
```kconfig
# sdkconfig.defaults.debug —— 开发/联调构建（明文日志开启，DEBUG 级别）
# 用法: idf.py -DSDKCONFIG_DEFAULTS="sdkconfig.defaults;sdkconfig.defaults.debug" build
CONFIG_APEX_DEBUG_PAYLOAD=y
CONFIG_LOG_DEFAULT_LEVEL_DEBUG=y

# ---- PSRAM 内存策略（与量产一致）----
CONFIG_SPIRAM=y
CONFIG_SPIRAM_MODE_OCT=y
CONFIG_SPIRAM_SPEED_80M=y
CONFIG_SPIRAM_MALLOC_ALWAYSINTERNAL=2048
CONFIG_SPIRAM_TRY_ALLOCATE_WIFI_LWIP=y
```
